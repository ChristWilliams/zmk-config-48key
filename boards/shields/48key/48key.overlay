#include <dt-bindings/zmk/matrix_transform.h>

/ {
    chosen {
        zmk,kscan = &default_kscan;
        zmk,matrix_transform = &default_transform;
    };

    default_kscan: kscan{
        compatible = "zmk,kscan-gpio-matrix";
        label = "default_kscan";
        diode-direction = "col2row";

        row-gpios = <&pro_micro 1 (GPIO_ACTIVE_HIGH | GPIO_PULL_DOWN)>,
                    <&pro_micro 2 (GPIO_ACTIVE_HIGH | GPIO_PULL_DOWN)>,
                    <&pro_micro 3 (GPIO_ACTIVE_HIGH | GPIO_PULL_DOWN)>,
                    <&pro_micro 4 (GPIO_ACTIVE_HIGH | GPIO_PULL_DOWN)>;

        col-gpios = <&pro_micro 5 GPIO_ACTIVE_HIGH>,
                    <&pro_micro 6 GPIO_ACTIVE_HIGH>,
                    <&pro_micro 7 GPIO_ACTIVE_HIGH>,
                    <&pro_micro 8 GPIO_ACTIVE_HIGH>,
                    <&pro_micro 9 GPIO_ACTIVE_HIGH>,
                    <&pro_micro 10 GPIO_ACTIVE_HIGH>,
                    <&pro_micro 16 GPIO_ACTIVE_HIGH>,
                    <&pro_micro 14 GPIO_ACTIVE_HIGH>,
                    <&pro_micro 15 GPIO_ACTIVE_HIGH>,
                    <&pro_micro 18 GPIO_ACTIVE_HIGH>,
                    <&pro_micro 19 GPIO_ACTIVE_HIGH>,
                    <&pro_micro 20 GPIO_ACTIVE_HIGH>;
    };
        
    default_transform: matrix_transform{
        compatible = "zmk,matrix_transform";
        rows = <4>;
        columns = <12>;

        map = <
            0  1  2  3  4  5  6  7  8  9 10 11  // Row 0 keys
            12 13 14 15 16 17 18 19 20 21 22 23  // Row 1 keys
            24 25 26 27 28 29 30 31 32 33 34 35  // Row 2 keys
            36 37 38 39 40 41 42 43 44 45 46 47  // Row 3 keys
        >;
    };
};