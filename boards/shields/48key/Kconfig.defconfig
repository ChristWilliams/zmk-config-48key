## boards/shields/48key/Kconfig.defconfig
```kconfig
if SHIELD_48KEY

config ZMK_KEYBOARD_NAME
    default "48key"


endif

if ZMK_BACKLIGHT

config PWM
    default y

config LED_PWM
    default y

endif # ZMK_BACKLIGHT
```
